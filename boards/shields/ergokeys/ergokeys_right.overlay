
/* ErgoKeys - RIGHT half (nice!nano / nRF52840)
 * If you are mirroring the matrix, you may want a col offset (default_transform).
 */

 / {
    chosen {
        zmk,split-role = "right";
    };
};

/* If your keymap indexes are continuous left→right, add a column offset here. 
 * For 6 columns on the left, offset = 6, etc. Adjust to your layout.
 */
&default_transform {
    col-offset = <6>;
};

/* Keyboard scan configuration for right half */
&kscan0 {
    /* Example column pins — replace with your actual pins */
    col-gpios =
        <&gpio0  2 GPIO_ACTIVE_HIGH>,
        <&gpio0  3 GPIO_ACTIVE_HIGH>,
        <&gpio0  4 GPIO_ACTIVE_HIGH>,
        <&gpio0  5 GPIO_ACTIVE_HIGH>,
        <&gpio0  6 GPIO_ACTIVE_HIGH>,
        <&gpio0  7 GPIO_ACTIVE_HIGH>;

    /* Example row pins — replace with your actual pins */
    row-gpios =
        <&gpio0  8 (GPIO_ACTIVE_HIGH | GPIO_PULL_UP)>,
        <&gpio0  9 (GPIO_ACTIVE_HIGH | GPIO_PULL_UP)>,
        <&gpio0 10 (GPIO_ACTIVE_HIGH | GPIO_PULL_UP)>;

    diode-direction = "col2row";
    status = "okay";
};
