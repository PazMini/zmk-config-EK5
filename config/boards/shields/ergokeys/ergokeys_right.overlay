#include "ergokeys.dtsi"

&default_transform { 
    col-offset = <6>;
};

&kscan0 {
    col-gpios
        = <&pro_micro 17 GPIO_ACTIVE_HIGH>
        , <&pro_micro 11 GPIO_ACTIVE_HIGH>
        , <&pro_micro 32 GPIO_ACTIVE_HIGH>
        , <&pro_micro 24 GPIO_ACTIVE_HIGH>
        , <&pro_micro 22 GPIO_ACTIVE_HIGH>
        , <&pro_micro 20 GPIO_ACTIVE_HIGH>
        ;
};

